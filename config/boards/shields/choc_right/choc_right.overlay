// choc_right.overlay — standalone right side, 5 rows × 7 cols

#include "../../../choc_right.dtsi"

&kscan0 {
    col-gpios
        = <&gpio0 9  (GPIO_ACTIVE_HIGH | GPIO_PULL_DOWN)>  // COL 1  D10  (P0.09) — lone key column
        , <&gpio0 31 (GPIO_ACTIVE_HIGH | GPIO_PULL_DOWN)>  // COL 2  D21  (P0.31)
        , <&gpio0 29 (GPIO_ACTIVE_HIGH | GPIO_PULL_DOWN)>  // COL 3  D20  (P0.29)
        , <&gpio1 15 (GPIO_ACTIVE_HIGH | GPIO_PULL_DOWN)>  // COL 4  D18  (P1.15)
        , <&gpio1 13 (GPIO_ACTIVE_HIGH | GPIO_PULL_DOWN)>  // COL 5  D15  (P1.13)
        , <&gpio1 11 (GPIO_ACTIVE_HIGH | GPIO_PULL_DOWN)>  // COL 6  D14  (P1.11)
        , <&gpio0 10 (GPIO_ACTIVE_HIGH | GPIO_PULL_DOWN)>  // COL 7  D16  (P0.10)
        ;

    row-gpios
        = <&gpio0 20 GPIO_ACTIVE_HIGH>  // ROW 1  D3   (P0.20)
        , <&gpio0 22 GPIO_ACTIVE_HIGH>  // ROW 2  D4   (P0.22)
        , <&gpio0 24 GPIO_ACTIVE_HIGH>  // ROW 3  D5   (P0.24)
        , <&gpio1 0  GPIO_ACTIVE_HIGH>  // ROW 4  D6   (P1.00)
        , <&gpio0 2  GPIO_ACTIVE_HIGH>  // ROW 5  D19  (P0.02)
        ;
};
