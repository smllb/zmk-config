## config/boards/shields/skeletyl_left/Kconfig.defconfig
```kconfig
CONFIG_ZMK_COMBO_MAX_COMBOS_PER_KEY=20
if SHIELD_SKELETYL_LEFT

config ZMK_KEYBOARD_NAME
	default "Skeletyl"

config ZMK_SPLIT_ROLE_CENTRAL
	default y

config ZMK_SPLIT_BLE_CENTRAL_PERIPHERALS
	default 1

endif
```

## config/boards/shields/skeletyl_right/Kconfig.defconfig
```kconfig
CONFIG_ZMK_COMBO_MAX_COMBOS_PER_KEY=20
if SHIELD_SKELETYL_RIGHT

config ZMK_KEYBOARD_NAME
	default "Skeletyl Right"

config ZMK_SPLIT_ROLE_CENTRAL
	default n

endif
```
