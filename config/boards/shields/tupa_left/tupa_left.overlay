#include "../../../tupa.dtsi"

&kscan0 {
    col-gpios
        = <&gpio0 2  GPIO_ACTIVE_HIGH>  // COL 1  D19  (P0.02)
        , <&gpio0 29 GPIO_ACTIVE_HIGH>  // COL 2  D20  (P0.29)
        , <&gpio1 0  GPIO_ACTIVE_HIGH>  // COL 3  D6   (P1.00)
        , <&gpio0 24 GPIO_ACTIVE_HIGH>  // COL 4  D5   (P0.24)
        , <&gpio0 31 GPIO_ACTIVE_HIGH>  // COL 5  D21  (P0.31)
        , <&gpio0 20 GPIO_ACTIVE_HIGH>  // COL 6  D3   (P0.20)
        , <&gpio0 22 GPIO_ACTIVE_HIGH>  // COL 7  D4   (P0.22)
        ;

    row-gpios
        = <&gpio1 15 (GPIO_ACTIVE_HIGH | GPIO_PULL_DOWN)>  // ROW 1  D18  (P1.15)
        , <&gpio1 13 (GPIO_ACTIVE_HIGH | GPIO_PULL_DOWN)>  // ROW 2  D15  (P1.13)
        , <&gpio1 11 (GPIO_ACTIVE_HIGH | GPIO_PULL_DOWN)>  // ROW 3  D14  (P1.11)
        , <&gpio0 10 (GPIO_ACTIVE_HIGH | GPIO_PULL_DOWN)>  // ROW 4  D16  (P0.10)
        , <&gpio0 9  (GPIO_ACTIVE_HIGH | GPIO_PULL_DOWN)>  // ROW 5  D10  (P0.09)
        ;
};
