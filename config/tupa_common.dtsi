#include <behaviors.dtsi>
#include <dt-bindings/zmk/keys.h>
#include <dt-bindings/zmk/bt.h>

// Shared behaviors for both sides
/ {
    behaviors {
        // placeholders for future shared behaviors
    };
};
