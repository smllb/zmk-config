#include <behaviors.dtsi>
#include <dt-bindings/zmk/keys.h>
#include <dt-bindings/zmk/bt.h>
#include <dt-bindings/zmk/outputs.h>

// Define behaviors shared between both sides
/ {
    behaviors {
        tg_d: toggle_d {
            compatible = "zmk,behavior-hold-tap";
            #binding-cells = <2>;
            flavor = "tap-preferred";
            tapping-term-ms = <200>;
            bindings = <&tog>, <&kp>;
            display-name = "Toggle-D";
        };
        
        tg_k: toggle_k {
            compatible = "zmk,behavior-hold-tap";
            #binding-cells = <2>;
            flavor = "tap-preferred";
            tapping-term-ms = <200>;
            bindings = <&tog>, <&kp>;
            display-name = "Toggle-K";
        };
    };
};
