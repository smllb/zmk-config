#include <dt-bindings/zmk/matrix_transform.h>
#include "tupa_common.dtsi"
#include "tupa_matrix.dtsi"

/ {
    chosen {
        zmk,matrix_transform = &default_transform;
        zmk,kscan = &kscan0;
    };

    kscan0: kscan_0 {
        compatible = "zmk,kscan-gpio-matrix";
        wakeup-source;
        diode-direction = "row2col";
    };
};
